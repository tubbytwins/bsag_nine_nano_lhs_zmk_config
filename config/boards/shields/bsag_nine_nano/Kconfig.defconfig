## config/boards/shields/bsag_nine_nano/Kconfig.defconfig
```kconfig
# Copyright (c) 2022 The ZMK Contributors
# SPDX-License-Identifier: MIT
#
# Remember: for BT keyboards, the length of ZMK_KEYBOARD_NAME has to be under 16 characters.

if SHIELD_BSAG_NINE_NANO

config ZMK_KEYBOARD_NAME
    default "BSAG NineNano L"

endif
```

## config/boards/shields/bsag_nine_nano/Kconfig.shield
```kconfig
# Copyright (c) 2022 The ZMK Contributors
# SPDX-License-Identifier: MIT

config SHIELD_BSAG_NINE_NANO
    def_bool $(shields_list_contains,bsag_nine_nano)
```

## config/boards/shields/supermini_testpins/Kconfig.defconfig
```kconfig
# Copyright (c) 2022 The ZMK Contributors
# SPDX-License-Identifier: MIT
#
# Remember: for BT keyboards, the length of ZMK_KEYBOARD_NAME has to be under 16 characters.

if SHIELD_SUPERMINI_TESTPINS

config ZMK_KEYBOARD_NAME
    default "superMINItest1"

endif
```

## config/boards/shields/supermini_testpins/Kconfig.shield
```kconfig
# Copyright (c) 2022 The ZMK Contributors
# SPDX-License-Identifier: MIT

config SHIELD_SUPERMINI_TESTPINS
    def_bool $(shields_list_contains,supermini_testpins)
```

## config/boards/shields/xiao_ble_testpins/Kconfig.defconfig
```kconfig
# Copyright (c) 2022 The ZMK Contributors
# SPDX-License-Identifier: MIT
#
# Remember: for BT keyboards, the length of ZMK_KEYBOARD_NAME has to be under 16 characters.

if SHIELD_XIAO_BLE_TESTPINS

config ZMK_KEYBOARD_NAME
    default "xiaoBLEtest1"

endif
```

## config/boards/shields/xiao_ble_testpins/Kconfig.shield
```kconfig
# Copyright (c) 2022 The ZMK Contributors
# SPDX-License-Identifier: MIT

config SHIELD_XIAO_BLE_TESTPINS
    def_bool $(shields_list_contains,xiao_ble_testpins)
```
